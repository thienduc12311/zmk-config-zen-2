## config/west.yml
```yaml
manifest:
  remotes:
    - name: thienduc12311
      url-base: https://github.com/thienduc12311
  projects:
    - name: zmk
      remote: thienduc12311
      revision: caksoylar/zen-v1+v2+experimental  # custom branch name
      import: app/west.yml
  self:
    path: config
```
